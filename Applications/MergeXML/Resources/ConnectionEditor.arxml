AUTOSAR XML (schema 4-2-1)
package /BMW/Boardnet/EcuComposition/KombiComposition
  composition sw component type Kombi_CPUComponent
    39 x component:
      iicb_Prototype: type=iicb
      IOSAL_Prototype: type=IOSAL
      SwcCDBus_Prototype: type=SwcCDBus
      SwcUcv_Prototype: type=SwcUcv
      CDDBIF_Prototype: type=CDDBIF
      SwcGear_Prototype: type=SwcGear
      CddVMon_Prototype: type=CddVMon
      SwcAtp_Prototype: type=SwcAtp
      SwcOdo_Prototype: type=SwcOdo
      SwcCcm_Prototype: type=SwcCcm
      SwcTnk_Prototype: type=SwcTnk
      CddErm_Prototype: type=CddErm
      SwcKlb_Prototype: type=SwcKlb
      BifSample_Prototype: type=BifSample
      SwcBc_Prototype: type=SwcBc
      HMIIF_Prototype: type=HMIIF
      SPD_Prototype: type=SPD
      PiaWrp_Prototype: type=PiaWrp
      SwcEci_Prototype: type=SwcEci
      SwcDim_Prototype: type=SwcDim
      AC_SAFM_Prototype: type=AC_SAFM
      SwcLdm_Prototype: type=SwcLdm
      SwcRda_Prototype: type=SwcRda
      SwcElc_Prototype: type=SwcElc
      CDD_AMM_Prototype: type=CDD_AMM
      CddStub_Prototype: type=CddStub
      SwcKsm_Prototype: type=SwcKsm
      SwcBcWrp_Prototype: type=SwcBcWrp
      SwcDimWrp_Prototype: type=SwcDimWrp
      CddSwcDfe_Prototype: type=CddSwcDfe
      CddDfeLld_Prototype: type=CddDfeLld
      SwcOdoWrp_Prototype: type=SwcOdoWrp
      SwcCcmWrp_Prototype: type=SwcCcmWrp
      SwcCbsWrp_Prototype: type=SwcCbsWrp
      CddSafMLLD_Prototype: type=CddSafMLLD
      CddHal_Prototype: type=CddHal
      SwcTST_Prototype: type=SwcTST
      SwcTmm_Prototype: type=SwcTmm
      SwcCbs_Prototype: type=SwcCbs
    connect CDDBIF_Prototype.pport_If_cs_AnyToBif -> BifSample_Prototype.rport_If_ca_BifSampleToBif
    connect BifSample_Prototype.pport_If_cs_BifToBifSample -> CDDBIF_Prototype.rport_If_cs_BifToSample
    connect SwcUcv_Prototype.pport_If_sr_Bc_Speed_To_Hmi -> HMIIF_Prototype.rport_If_sr_Bc_Speed_To_Hmi
    connect SwcUcv_Prototype.pport_If_sr_Bc_Range_To_Hmi -> HMIIF_Prototype.rport_If_sr_Bc_Range_To_Hmi
    connect SwcUcv_Prototype.pport_If_sr_Atp_To_Hmi -> HMIIF_Prototype.rport_If_sr_Atp_To_Hmi
    connect SwcUcv_Prototype.pport_If_sr_Bc_Average_To_Hmi -> HMIIF_Prototype.rport_If_sr_Bc_Average_To_Hmi
    connect SwcUcv_Prototype.pport_If_sr_Bc_Consumption_To_Hmi -> HMIIF_Prototype.rport_If_sr_Bc_Consumption_To_Hmi
    connect SwcUcv_Prototype.pport_If_sr_Tnk_To_Hmi -> HMIIF_Prototype.rport_If_sr_Tnk_To_Hmi
    connect SwcUcv_Prototype.pport_If_sr_Odo_To_Hmi -> HMIIF_Prototype.rport_If_sr_Odo_To_Hmi
    connect SwcUcv_Prototype.pport_If_sr_Hmi_TestMenu -> HMIIF_Prototype.rport_If_sr_Hmi_TestMenu
    connect HMIIF_Prototype.pport_If_cs_HMI_TM -> SwcUcv_Prototype.rport_If_cs_HMI_TM
    connect SwcUcv_Prototype.pport_If_sr_Ucv_HmiGaugeValues -> HMIIF_Prototype.rport_If_sr_Ucv_HmiGaugeValues
    connect Bs.SecEcuMode -> SecM.SecEcuMode
    connect Bs.LifeCycle -> SecM.LifeCycle
    connect SwcUcv_Prototype.pport_If_cs_Ucv_Converter -> SwcBc_Prototype.rport_If_cs_Ucv_Converter
    connect SwcBc_Prototype.pport_If_sr_Bc_Range -> SwcUcv_Prototype.rport_If_sr_Bc_Range
    connect SwcBc_Prototype.pport_If_sr_Bc_Speed -> SwcUcv_Prototype.rport_If_sr_Bc_Speed
    connect SwcBc_Prototype.pport_If_sr_Bc_Consumption -> SwcUcv_Prototype.rport_If_sr_Bc_Consumption
    connect SwcTnk_Prototype.pport_If_sr_Tnk -> SwcUcv_Prototype.rport_If_sr_Tnk
    connect SwcAtp_Prototype.pport_If_sr_Atp -> SwcUcv_Prototype.rport_If_sr_Atp
    connect SwcOdo_Prototype.pport_If_sr_Odo -> SwcUcv_Prototype.rport_If_sr_Odo
    connect SwcBc_Prototype.pport_If_sr_Bc_Average -> SwcUcv_Prototype.rport_If_sr_Bc_Average
    connect SwcBc_Prototype.pport_If_sr_Bc2_Trip -> SwcUcv_Prototype.rport_If_sr_Bc2_Trip
    connect SwcAtp_Prototype.pport_If_cs_Atp_TM -> SwcUcv_Prototype.rport_If_cs_Atp_TM
    connect SwcBc_Prototype.pport_If_cs_Bc_TM -> SwcUcv_Prototype.rport_If_cs_Bc_TM
    connect SwcTnk_Prototype.pport_If_cs_Tnk_TM -> SwcUcv_Prototype.rport_If_cs_Tnk_TM
    connect CddVMon_Prototype.pport_If_cs_VMon_TM -> SwcUcv_Prototype.rport_If_cs_VMon_TM
    connect SwcCcm_Prototype.pport_If_cs_Cc_TM -> SwcUcv_Prototype.rport_If_cs_Cc_TM
    connect SwcUcv_Prototype.pport_If_sr_Ucv_HmiGaugeValues -> SPD_Prototype.rport_If_sr_Ucv_HmiGaugeValues
    connect SwcUcv_Prototype.pport_If_sr_Ucv_HmiGaugeValues -> SwcBc_Prototype.rport_If_sr_Ucv_HmiGaugeValues
    connect CddErm_Prototype.pport_If_sr_Erm_Rx_Frame_DISP_RPM_PT -> SwcUcv_Prototype.rport_If_sr_Erm_Rx_Frame_DISP_RPM_PT
    connect CddErm_Prototype.pport_If_sr_Erm_Rx_Frame_ST_COSP_FU_ENG -> SwcUcv_Prototype.rport_If_sr_Erm_Rx_Frame_ST_COSP_FU_ENG
    connect CddErm_Prototype.pport_If_cs_Erm -> SwcUcv_Prototype.rport_If_cs_Erm
    connect SwcBc_Prototype.pport_If_sr_Bc_Eco -> SwcUcv_Prototype.rport_If_sr_Bc_Eco
    connect SPD_Prototype.pport_If_sr_Speed -> SwcUcv_Prototype.rport_If_sr_Speed
    connect SwcUcv_Prototype.pport_If_sr_Ucv_Speed -> SwcBc_Prototype.rport_If_sr_Ucv_Speed
    connect CddErm_Prototype.pport_If_sr_Erm_Rx_Frame_RCOG_TRSG -> SwcUcv_Prototype.rport_If_sr_Erm_Rx_Frame_RCOG_TRSG
    connect CddErm_Prototype.pport_If_sr_Erm_Rx_Frame_DISP_CON_HYB -> SwcUcv_Prototype.rport_If_sr_Erm_Rx_Frame_DISP_CON_HYB
    connect SwcBc_Prototype.pport_If_sr_BcFlags -> SwcUcv_Prototype.rport_If_sr_BcFlags
    connect CddErm_Prototype.pport_If_sr_Erm_Rx_Frame_CON_VEH -> SwcUcv_Prototype.rport_If_sr_Erm_Rx_Frame_CON_VEH
    connect SwcBc_Prototype.pport_If_sr_Bc_CanMsgDtKi -> SwcUcv_Prototype.rport_If_sr_Bc_CanMsgDtKi
    connect SwcGear_Prototype.pport_If_sr_GearData -> SwcUcv_Prototype.rport_If_sr_Gear
    connect SPD_Prototype.pport_If_sr_Speed -> SwcGear_Prototype.rport_If_sr_Speed
    connect CddErm_Prototype.pport_If_sr_Erm_Rx_Frame_DT_DISP_GRDT -> SwcGear_Prototype.rport_If_sr_Erm_Rx_Frame_DT_DISP_GRDT
    connect CddErm_Prototype.pport_If_sr_Erm_Rx_Frame_DISP_RPM_PT -> SwcGear_Prototype.rport_If_sr_Erm_Rx_Frame_DISP_RPM_PT
    connect CddErm_Prototype.pport_If_sr_Erm_Rx_Frame_CON_VEH -> SwcGear_Prototype.rport_If_sr_Erm_Rx_Frame_CON_VEH
    connect CddErm_Prototype.pport_If_cs_Erm -> SwcGear_Prototype.rport_If_cs_Erm
    connect CddErm_Prototype.pport_If_cs_Erm -> CddVMon_Prototype.rport_If_cs_Erm
    connect SwcAtp_Prototype.pport_If_sr_Atp -> SwcBc_Prototype.rport_If_sr_Atp
    connect CddErm_Prototype.pport_If_sr_Erm_Rx_Frame_DT_PT_2 -> SwcAtp_Prototype.rport_If_sr_Erm_Rx_Frame_DT_PT_2
    connect SPD_Prototype.pport_If_sr_Speed -> SwcAtp_Prototype.rport_If_sr_Speed
    connect SwcOdo_Prototype.pport_If_sr_Odo -> SwcCcm_Prototype.rport_If_sr_Odo
    connect SwcOdo_Prototype.pport_If_sr_Odo -> SwcBc_Prototype.rport_If_sr_Odo
    connect CddErm_Prototype.pport_If_cs_Erm -> SwcOdo_Prototype.rport_If_cs_Erm
    connect CddErm_Prototype.pport_If_sr_Erm_Rx_Frame_MILE_VEH -> SwcOdo_Prototype.rport_If_sr_Erm_Rx_Frame_MILE_VEH
    connect SPD_Prototype.pport_If_sr_Speed -> SwcOdo_Prototype.rport_If_sr_Speed
    connect SwcCcm_Prototype.pport_If_cs_Ccm_GetDisplayedCCID -> SwcBc_Prototype.rport_If_cs_Ccm_GetDisplayedCCID
    connect SwcCcm_Prototype.pport_If_cs_Ccm_SetClrMessage -> CddErm_Prototype.rport_If_cs_Ccm_SetClrMessage
    connect SwcCcm_Prototype.pport_If_cs_Ccm_CanCallback -> CddErm_Prototype.rport_If_cs_Ccm_CanCallback
    connect CddErm_Prototype.pport_If_cs_Erm -> SwcCcm_Prototype.rport_If_cs_Erm
    connect SPD_Prototype.pport_If_sr_Speed -> SwcCcm_Prototype.rport_If_sr_Speed
    connect SwcKlb_Prototype.pport_If_cs_Ccm_LampStatus_To_Klb -> SwcCcm_Prototype.rport_If_cs_Ccm_LampStatus_To_Klb
    connect CddErm_Prototype.pport_If_sr_Erm_Rx_Frame_ST_RCP -> SwcCcm_Prototype.rport_If_sr_Erm_Rx_Frame_ST_RCP
    connect SwcTnk_Prototype.pport_If_sr_Tnk -> SwcBc_Prototype.rport_If_sr_Tnk
    connect CddErm_Prototype.pport_If_sr_Erm_Rx_Frame_RAW_DATA_TANK -> SwcTnk_Prototype.rport_If_sr_Erm_Rx_Frame_RAW_DATA_TANK
    connect CddErm_Prototype.pport_If_sr_Erm_Rx_Frame_ST_COSP_FU_ENG -> SwcTnk_Prototype.rport_If_sr_Erm_Rx_Frame_ST_COSP_FU_ENG
    connect CddErm_Prototype.pport_If_cs_Erm -> SwcTnk_Prototype.rport_If_cs_Erm
    connect SPD_Prototype.pport_If_sr_Speed -> SwcTnk_Prototype.rport_If_sr_Speed
    connect CddErm_Prototype.pport_If_sr_Erm_Rx_Frame_ACLNX_MASSCNTR -> SwcTnk_Prototype.rport_If_sr_Erm_Rx_Frame_ACLNX_MASSCNTR
    connect CddErm_Prototype.pport_If_sr_Erm_Rx_Frame_ACLNY_MASSCNTR -> SwcTnk_Prototype.rport_If_sr_Erm_Rx_Frame_ACLNY_MASSCNTR
    connect CddErm_Prototype.pport_If_sr_Erm_Rx_Frame_TLT_RW -> SwcTnk_Prototype.rport_If_sr_Erm_Rx_Frame_TLT_RW
    connect CddErm_Prototype.pport_If_sr_Erm_Rx_Frame_DISP_DT_HVSTO -> SwcTnk_Prototype.rport_If_sr_Erm_Rx_Frame_DISP_DT_HVSTO
    connect CddErm_Prototype.pport_If_sr_Erm_Rx_Frame_DISP_CON_HYB -> SwcTnk_Prototype.rport_If_sr_Erm_Rx_Frame_DISP_CON_HYB
    connect SwcBc_Prototype.pport_If_sr_Bc_Range -> SwcTnk_Prototype.rport_If_sr_Bc_Range
    connect CddErm_Prototype.pport_If_cs_Erm -> SwcKlb_Prototype.rport_If_cs_Erm
    connect CddErm_Prototype.pport_If_cs_Erm -> SwcBc_Prototype.rport_If_cs_Erm
    connect CddErm_Prototype.pport_If_sr_Erm_Rx_Frame_ST_CENG -> SwcKlb_Prototype.rport_If_sr_Erm_Rx_Frame_ST_CENG
    connect CddErm_Prototype.pport_If_sr_Erm_Rx_Frame_ST_CENG -> SwcBc_Prototype.rport_If_sr_Erm_Rx_Frame_ST_CENG
    connect CddErm_Prototype.pport_If_sr_Erm_Rx_Frame_DISP_COSA_HYB -> SwcBc_Prototype.rport_If_sr_Erm_Rx_Frame_DISP_COSA_HYB
    connect CddErm_Prototype.pport_If_sr_Erm_Rx_Frame_DT_DISP_GRDT -> SwcBc_Prototype.rport_If_sr_Erm_Rx_Frame_DT_DISP_GRDT
    connect CddErm_Prototype.pport_If_sr_Erm_Rx_Frame_DT_PT_2 -> SwcBc_Prototype.rport_If_sr_Erm_Rx_Frame_DT_PT_2
    connect CddErm_Prototype.pport_If_sr_Erm_Rx_Frame_CHGNG_ST -> SwcBc_Prototype.rport_If_sr_Erm_Rx_Frame_CHGNG_ST
    connect CddErm_Prototype.pport_If_sr_Erm_Rx_Frame_DXP_MOD -> SwcBc_Prototype.rport_If_sr_Erm_Rx_Frame_DXP_MOD
    connect CddErm_Prototype.pport_If_sr_Erm_Rx_Frame_ST_CHGINTF -> SwcBc_Prototype.rport_If_sr_Erm_Rx_Frame_ST_CHGINTF
    connect CddErm_Prototype.pport_If_sr_Erm_Rx_Frame_DISP_CON_HYB -> SwcBc_Prototype.rport_If_sr_Erm_Rx_Frame_DISP_CON_HYB
    connect CddErm_Prototype.pport_If_sr_Erm_Rx_Frame_ST_MAB_ASST -> SwcKlb_Prototype.rport_If_sr_Erm_Rx_Frame_ST_MAB_ASST
    connect CddErm_Prototype.pport_If_sr_Erm_Rx_Frame_DT_RNG_CALC -> SwcBc_Prototype.rport_If_sr_Erm_Rx_Frame_DT_RNG_CALC
    connect CddErm_Prototype.pport_If_sr_Erm_Rx_Frame_SYS_ST_EVEH_DRV -> SwcBc_Prototype.rport_If_sr_Erm_Rx_Frame_SYS_ST_EVEH_DRV
    connect CddErm_Prototype.pport_If_sr_Erm_Rx_Frame_CHGNG_ST_2 -> SwcBc_Prototype.rport_If_sr_Erm_Rx_Frame_CHGNG_ST_2
    connect CddErm_Prototype.pport_If_sr_Erm_Rx_Frame_ST_COSP_FU_ENG -> SwcBc_Prototype.rport_If_sr_Erm_Rx_Frame_ST_COSP_FU_ENG
    connect CddErm_Prototype.pport_If_sr_Erm_Rx_Frame_MILE_VEH -> SwcBc_Prototype.rport_If_sr_Erm_Rx_Frame_MILE_VEH
    connect CddErm_Prototype.pport_If_sr_Erm_Rx_Frame_DISP_PWR_DRV -> SwcBc_Prototype.rport_If_sr_Erm_Rx_Frame_DISP_PWR_DRV
    connect CddErm_Prototype.pport_If_sr_Erm_Rx_Frame_DISP_FRSG -> SwcBc_Prototype.rport_If_sr_Erm_Rx_Frame_DISP_FRSG
    connect CddErm_Prototype.pport_If_sr_Erm_Rx_Frame_AVL_RPM_WHL_UPRT -> SwcBc_Prototype.rport_If_sr_Erm_Rx_Frame_AVL_RPM_WHL_UPRT
    connect CddErm_Prototype.pport_If_sr_Erm_Rx_Frame_LAMPENZUSTAND -> SwcKlb_Prototype.rport_If_sr_Erm_Rx_Frame_LAMPENZUSTAND
    connect CddErm_Prototype.pport_If_sr_Erm_Rx_Frame_DT_RNG_CALC_2 -> SwcBc_Prototype.rport_If_sr_Erm_Rx_Frame_DT_RNG_CALC_2
    connect CddErm_Prototype.pport_If_sr_Erm_Rx_Frame_RQ_AIC_1 -> SwcBc_Prototype.rport_If_sr_Erm_Rx_Frame_RQ_AIC_1
    connect CddErm_Prototype.pport_If_sr_Erm_Rx_Frame_BLINKEN -> SwcKlb_Prototype.rport_If_sr_Erm_Rx_Frame_BLINKEN
    connect CddErm_Prototype.pport_If_sr_Erm_Rx_Frame_V_VEH -> SPD_Prototype.rport_If_sr_Erm_Rx_Frame_V_VEH
    connect CddErm_Prototype.pport_If_sr_Erm_Rx_Frame_ST_STAB_DSC -> SwcBc_Prototype.rport_If_sr_Erm_Rx_Frame_ST_STAB_DSC
    connect CddErm_Prototype.pport_If_sr_Erm_Rx_Frame_TLT_RW -> SwcBc_Prototype.rport_If_sr_Erm_Rx_Frame_TLT_RW
    connect CddErm_Prototype.pport_If_sr_Erm_Rx_Frame_DISP_RPM_PT -> SwcBc_Prototype.rport_If_sr_Erm_Rx_Frame_DISP_RPM_PT
    connect CddErm_Prototype.pport_If_sr_Erm_Rx_Frame_ANG_ACPD -> SwcBc_Prototype.rport_If_sr_Erm_Rx_Frame_ANG_ACPD
    connect CddErm_Prototype.pport_If_sr_Erm_Rx_Frame_TORQ_CRSH_1 -> SwcBc_Prototype.rport_If_sr_Erm_Rx_Frame_TORQ_CRSH_1
    connect CddErm_Prototype.pport_If_sr_Erm_Rx_Frame_WMOM_DRV_1 -> SwcBc_Prototype.rport_If_sr_Erm_Rx_Frame_WMOM_DRV_1
    connect CddErm_Prototype.pport_If_sr_Erm_Rx_Frame_CON_VEH -> SPD_Prototype.rport_If_sr_Erm_Rx_Frame_CON_VEH
    connect CddErm_Prototype.pport_If_sr_Erm_Rx_Frame_CON_VEH -> SwcKlb_Prototype.rport_If_sr_Erm_Rx_Frame_CON_VEH
    connect CddErm_Prototype.pport_If_sr_Erm_Rx_Frame_CON_VEH -> SwcBc_Prototype.rport_If_sr_Erm_Rx_Frame_CON_VEH
    connect CddErm_Prototype.pport_If_sr_Erm_Rx_Frame_DISP_DT_HVSTO -> SwcBc_Prototype.rport_If_sr_Erm_Rx_Frame_DISP_DT_HVSTO
    connect SwcKlb_Prototype.pport_If_cs_Klb_Callback -> CddErm_Prototype.rport_If_cs_Klb_Callback
    connect CddErm_Prototype.pport_If_sr_Erm_Rx_Frame_CTR_FN_IDC -> SwcKlb_Prototype.rport_If_sr_Erm_Rx_Frame_CTR_FN_IDC
    connect CddErm_Prototype.pport_If_sr_Erm_Rx_Frame_ST_OP_LP_EX -> SwcKlb_Prototype.rport_If_sr_Erm_Rx_Frame_ST_OP_LP_EX
    connect CddErm_Prototype.pport_If_sr_Erm_Rx_Frame_DISP_SW_DRDY_TECGY_EXPI -> SwcBc_Prototype.rport_If_sr_Erm_Rx_Frame_DISP_SW_DRDY_TECGY_EXPI
    connect CddErm_Prototype.pport_If_sr_Erm_Rx_Frame_CTR_IDLIS -> SwcKlb_Prototype.rport_If_sr_Erm_Rx_Frame_CTR_IDLIS
    connect SPD_Prototype.pport_If_sr_Speed -> SwcKlb_Prototype.rport_If_sr_Speed
    connect SPD_Prototype.pport_If_sr_Speed -> SwcBc_Prototype.rport_If_sr_Speed
    connect PiaWrp_Prototype.BcContentConfigurationPart1 -> PiaClient.BcContentConfigurationPart1
    connect PiaWrp_Prototype.ClusterBrightnessOffset -> PiaClient.ClusterBrightnessOffset
    connect PiaWrp_Prototype.ClusterDisplayConfiguration -> PiaClient.ClusterDisplayConfiguration
    connect PiaWrp_Prototype.DateFormat -> PiaClient.DateFormat
    connect PiaWrp_Prototype.DistanceUnit -> PiaClient.DistanceUnit
    connect PiaWrp_Prototype.ElectricConsumption -> PiaClient.ElectricConsumption
    connect PiaWrp_Prototype.FesSelection -> PiaClient.FesSelection
    connect PiaWrp_Prototype.FuelConsumption -> PiaClient.FuelConsumption
    connect PiaWrp_Prototype.FuelUnit -> PiaClient.FuelUnit
    connect PiaWrp_Prototype.Language -> PiaClient.Language
    connect PiaWrp_Prototype.LastBcEntry -> PiaClient.LastBcEntry
    connect PiaWrp_Prototype.PowerTorqueUnit -> PiaClient.PowerTorqueUnit
    connect PiaWrp_Prototype.PresetConfiguration -> PiaClient.PresetConfiguration
    connect PiaWrp_Prototype.PreassureUnit -> PiaClient.PressureUnit
    connect PiaWrp_Prototype.TemperatureUnit -> PiaClient.TemperatureUnit
    connect PiaWrp_Prototype.TimeFormat -> PiaClient.TimeFormat
    connect PiaClient.PiaApplMakePersistent -> PiaWrp_Prototype.PiaClient_MakePersistent
    connect PiaClient.PiaFunctionUpdateValue_BcContentConfigurationPart1 -> PiaWrp_Prototype.PiaClient_UpdateValue_BcContentConfigurationPart1
    connect PiaClient.PiaFunctionUpdateValue_ClusterBrightnessOffset -> PiaWrp_Prototype.PiaClient_UpdateValue_ClusterBrightnessOffset
    connect PiaClient.PiaFunctionUpdateValue_ClusterDisplayConfiguration -> PiaWrp_Prototype.PiaClient_UpdateValue_ClusterDisplayConfiguration
    connect PiaClient.PiaFunctionUpdateValue_DateFormat -> PiaWrp_Prototype.PiaClient_UpdateValue_DateFormat
    connect PiaClient.PiaFunctionUpdateValue_DistanceUnit -> PiaWrp_Prototype.PiaClient_UpdateValue_DistanceUnit
    connect PiaClient.PiaFunctionUpdateValue_ElectricConsumption -> PiaWrp_Prototype.PiaClient_UpdateValue_ElectricConsumption
    connect PiaClient.PiaFunctionUpdateValue_FesSelection -> PiaWrp_Prototype.PiaClient_UpdateValue_FesSelection
    connect PiaClient.PiaFunctionUpdateValue_FuelConsumption -> PiaWrp_Prototype.PiaClient_UpdateValue_FuelConsumption
    connect PiaClient.PiaFunctionUpdateValue_FuelUnit -> PiaWrp_Prototype.PiaClient_UpdateValue_FuelUnit
    connect PiaClient.PiaFunctionUpdateValue_Language -> PiaWrp_Prototype.PiaClient_UpdateValue_Language
    connect PiaClient.PiaFunctionUpdateValue_LastBcEntry -> PiaWrp_Prototype.PiaClient_UpdateValue_LastBcEntry
    connect PiaClient.PiaFunctionUpdateValue_PowerTorqueUnit -> PiaWrp_Prototype.PiaClient_UpdateValue_PowerTorqueUnit
    connect PiaClient.PiaFunctionUpdateValue_PresetConfiguration -> PiaWrp_Prototype.PiaClient_UpdateValue_PresetConfiguration
    connect PiaClient.PiaFunctionUpdateValue_PressureUnit -> PiaWrp_Prototype.PiaClient_UpdateValue_PreassureUnit
    connect PiaClient.PiaFunctionUpdateValue_TemperatureUnit -> PiaWrp_Prototype.PiaClient_UpdateValue_TemperatureUnit
    connect PiaClient.PiaFunctionUpdateValue_TimeFormat -> PiaWrp_Prototype.PiaClient_UpdateValue_TimeFormat
    connect PiaWrp_Prototype.pport_If_sr_PIA_ProfileData -> SwcUcv_Prototype.rport_If_PIA_ProfileData
    connect PiaWrp_Prototype.pport_If_sr_PIA_ProfileData -> SwcGear_Prototype.rport_If_PIA_ProfileData
    connect CddErm_Prototype.pport_If_cs_Erm -> PiaWrp_Prototype.rport_If_cs_Erm
    connect CddErm_Prototype.pport_If_sr_Erm_Rx_Frame_DXP_MOD -> PiaWrp_Prototype.rport_If_sr_Erm_Rx_Frame_DXP_MOD
    connect CddErm_Prototype.pport_If_sr_Erm_Rx_Frame_DISP_FRSG -> PiaWrp_Prototype.rport_If_sr_Erm_Rx_Frame_DISP_FRSG
    connect CddErm_Prototype.pport_If_sr_Erm_Rx_Frame_CON_VEH -> PiaWrp_Prototype.rport_If_sr_Erm_Rx_Frame_CON_VEH
    connect PiaWrp_Prototype.pport_If_sr_PIA_ProfileData -> SwcBc_Prototype.rport_If_PIA_ProfileData
    connect PiaWrp_Prototype.pport_If_sr_PIA_ProfileData -> PiaWrp_Prototype.rport_If_sr_PIA_ProfileData
    connect Det.DS_AC_SAFM -> AC_SAFM_Prototype.DETService_ACSAFM
    connect CDDBIF_Prototype.pport_If_cs_AnyToBif -> SecM.rport_If_cs_SecMToBif
    connect SwcUcv_Prototype.pport_If_sr_BordcomputerAverage -> HMIIF_Prototype.rport_If_sr_BordcomputerAverage
    connect SwcUcv_Prototype.pport_If_sr_Ucv_Speed -> HMIIF_Prototype.rport_If_sr_Ucv_Speed
    connect SwcUcv_Prototype.pport_If_sr_Odo_To_AuthHandlerGSSProxy -> HMIIF_Prototype.rport_If_sr_Odo_To_AuthHandlerGSSProxy
    connect SwcGear_Prototype.pport_If_sr_GearData -> HMIIF_Prototype.rport_If_sr_GearData
    connect SwcTnk_Prototype.pport_If_sr_Tnk -> HMIIF_Prototype.rport_If_sr_Tnk
    connect CddErm_Prototype.pport_If_sr_Erm_Rx_Frame_DISP_CON_HYB -> HMIIF_Prototype.rport_If_sr_Erm_Rx_Frame_DISP_CON_HYB
    connect CddErm_Prototype.pport_If_sr_Erm_Rx_Frame_SYS_ST_EVEH_DRV -> HMIIF_Prototype.rport_If_sr_Erm_Rx_Frame_SYS_ST_EVEH_DRV
    connect CddErm_Prototype.pport_If_sr_Erm_Rx_Frame_ST_COSP_FU_ENG -> HMIIF_Prototype.rport_If_sr_Erm_Rx_Frame_ST_COSP_FU_ENG
    connect CddErm_Prototype.pport_If_sr_Erm_Rx_Frame_DISP_PWR_DRV -> HMIIF_Prototype.rport_If_sr_Erm_Rx_Frame_DISP_PWR_DRV
    connect CddErm_Prototype.pport_If_sr_Erm_Rx_Frame_DISP_RPM_PT -> HMIIF_Prototype.rport_If_sr_Erm_Rx_Frame_DISP_RPM_PT
    connect CddErm_Prototype.pport_If_sr_Erm_Rx_Frame_CON_VEH -> HMIIF_Prototype.rport_If_sr_Erm_Rx_Frame_CON_VEH
    connect SwcKlb_Prototype.pport_If_sr_Klb_LampStatus_To_Hmi -> HMIIF_Prototype.rport_If_sr_Klb_LampStatus_To_Hmi
    connect SwcKlb_Prototype.pport_If_sr_Klb_Telltale -> HMIIF_Prototype.rport_If_sr_Klb_Telltale
    connect SwcBc_Prototype.pport_If_sr_Bc_ConsumptionHistory2 -> HMIIF_Prototype.rport_If_sr_Bc_ConsumptionHistory2
    connect PiaWrp_Prototype.pport_If_sr_PIA_ProfileData -> HMIIF_Prototype.rport_If_PIA_ProfileData
    connect SwcElc_Prototype.pport_If_sr_Elc_PowermeterCoding -> HMIIF_Prototype.rport_If_sr_Elc_PowermeterCoding
    connect SwcElc_Prototype.pport_If_sr_Elc_PowermeterQuick -> HMIIF_Prototype.rport_If_sr_Elc_PowermeterQuick
    connect SwcElc_Prototype.pport_If_sr_Elc_PowermeterStandard -> HMIIF_Prototype.rport_If_sr_Elc_PowermeterStandard
    connect SwcRda_Prototype.pport_If_sr_Rda -> HMIIF_Prototype.rport_If_sr_Rda
    connect CDD_AMM_Prototype.pport_If_cs_BifToAMM -> CDDBIF_Prototype.rport_If_cs_BifToAMM
    connect CddStub_Prototype.pport_If_sr_Clock -> SwcAtp_Prototype.rport_If_sr_Clock
    connect CddErm_Prototype.pport_If_sr_Erm_Rx_Frame_RawDataTempEx -> SwcAtp_Prototype.rport_If_sr_Erm_Rx_Frame_RawDataTempEx
    connect SwcKsm_Prototype.PPort_If_sr_System -> SwcAtp_Prototype.rport_If_sr_System
    connect SwcCDBus_Prototype.pport_If_cs_CDBus -> SwcKsm_Prototype.rport_If_cs_CDBus
    connect SwcAtp_Prototype.pport_If_cs_FubiStd -> SwcKsm_Prototype.RPort_If_cs_FubiStd_Atp
    connect SwcCcm_Prototype.pport_If_cs_FubiStd -> SwcKsm_Prototype.RPort_If_cs_FubiStd_Ccm
    connect SwcTnk_Prototype.pport_If_cs_FubiStd -> SwcKsm_Prototype.RPort_If_cs_FubiStd_Tnk
    connect CddErm_Prototype.pport_If_sr_Erm_Rx_Frame_ST_CENG -> SwcKsm_Prototype.RPort_If_sr_Erm_Rx_Frame_ST_CENG
    connect CddErm_Prototype.pport_If_sr_Erm_Rx_Frame_DISP_CON_HYB -> SwcKsm_Prototype.rport_If_sr_Erm_Rx_Frame_DISP_CON_HYB
    connect CddErm_Prototype.pport_If_sr_Erm_Rx_Frame_STAT_ENG_STA_AUTO -> SwcKsm_Prototype.rport_If_sr_Erm_Rx_Frame_STAT_ENG_STA_AUTO
    connect CddErm_Prototype.pport_If_sr_Erm_Rx_Frame_SYS_ST_EVEH_DRV -> SwcKsm_Prototype.rport_If_sr_Erm_Rx_Frame_SYS_ST_EVEH_DRV
    connect CddErm_Prototype.pport_If_sr_Erm_Rx_Frame_V_VEH -> SwcKsm_Prototype.RPort_If_sr_Erm_Rx_Frame_V_VEH
    connect CddErm_Prototype.pport_If_sr_Erm_Rx_Frame_CON_VEH -> SwcKsm_Prototype.RPort_If_sr_Erm_Rx_Frame_CON_VEH
    connect CddErm_Prototype.pport_If_sr_Erm_Rx_Frame_STAT_ZV_KLAPPEN -> SwcKsm_Prototype.RPort_If_sr_Erm_Rx_Frame_STAT_ZV_KLAPPEN
    connect SwcKlb_Prototype.pport_If_cs_Klb -> SwcKsm_Prototype.RPort_If_cs_Klb
    connect HMIIF_Prototype.pport_If_sr_SwcKsm_Hmi_RequestGeneral -> SwcKsm_Prototype.rport_If_sr_SwcKsm_Hmi_RequestGeneral
    connect PiaWrp_Prototype.pport_If_sr_PIA_ProfileData -> SwcKsm_Prototype.rport_If_sr_Pia_ProfileData
    connect SwcKsm_Prototype.PPort_If_sr_System -> SwcCcm_Prototype.rport_If_sr_System
    connect SwcKsm_Prototype.PPort_If_sr_System -> SwcTnk_Prototype.rport_If_sr_System
    connect SwcKsm_Prototype.PPort_If_sr_System -> SwcBc_Prototype.rport_If_sr_System
    connect SwcTnk_Prototype.pport_If_sr_Tnk -> SwcBcWrp_Prototype.rport_If_sr_Tnk
    connect SwcBc_Prototype.pport_If_sr_Bc_Range -> SwcBcWrp_Prototype.rport_If_sr_Bc_Range
    connect DiagAppl.PPort_If_RoutineServices_ActivateActivationLine -> DcmInstance.RoutineServices_ActivateActivationLine
    connect DiagAppl.PPort_If_DataServices_DcmDspData_DisplayedMileage -> DcmInstance.DataServices_DcmDspData_DisplayedMileage
    connect DiagAppl.PPort_If_DataServices_DcmDspData_ReadOnboardSystemVoltage -> DcmInstance.DataServices_DcmDspData_ReadOnboardSystemVoltage
    connect CddVMon_Prototype.pport_If_cs_VMon_Diag -> DiagAppl.RPort_if_cs_VMon_Diag
    connect SwcOdo_Prototype.pport_If_cs_Odo_Diag -> DiagAppl.RPort_If_cs_Odo_Diag
    connect SwcCcm_Prototype.pport_If_cs_Ccm_Diag -> DiagAppl.RPort_if_cs_Ccm_Diag
    connect SwcKsm_Prototype.PPort_If_sr_System -> SwcKlb_Prototype.rport_If_sr_System
    connect CddSwcDfe_Prototype.pport_If_sr_Dfe_Status -> SwcKlb_Prototype.rport_If_sr_Dfe_Status
    connect SwcKsm_Prototype.PPort_If_sr_System -> SwcGear_Prototype.rport_If_sr_System
    connect SwcCcm_Prototype.pport_If_cs_Ccm_Msg_Cbk -> SwcCcmWrp_Prototype.rport_If_cs_Ccm_Msg_Cbk
    connect SwcCcmWrp_Prototype.pport_If_cs_Ccm_Msg -> SwcCcm_Prototype.rport_If_cs_Ccm_Msg
    connect CddErm_Prototype.pport_If_sr_Erm_Rx_Frame_STAT_KLIMA_STAND -> SwcKlb_Prototype.rport_If_sr_Erm_Rx_Frame_STAT_KLIMA_STAND
    connect SwcCcmWrp_Prototype.pport_If_sr_CcmToHmi -> HMIIF_Prototype.rport_If_sr_CcmToHmi
    connect SwcTST_Prototype.pport_If_cs_General_TM -> SwcUcv_Prototype.rport_If_cs_General_TM
    connect SwcUcv_Prototype.pport_If_sr_Ucv_HmiGaugeValues -> SwcTST_Prototype.rport_If_sr_Tch
    connect SwcUcv_Prototype.pport_If_sr_Ucv_Speed -> SwcTST_Prototype.rport_If_sr_Ucv_Speed
    connect CddErm_Prototype.pport_If_sr_Erm_Rx_Frame_CHNO_COV_V -> SwcTST_Prototype.rport_If_sr_Erm_Rx_Frame_CHNO_V_VEH_COG
    connect CddErm_Prototype.pport_If_sr_Erm_Rx_Frame_DIMMUNG -> SwcTST_Prototype.rport_If_sr_Erm_Rx_Frame_DIMMUNG
    connect CddErm_Prototype.pport_If_sr_Erm_Rx_Frame_CON_VEH -> SwcTST_Prototype.rport_If_sr_Erm_Rx_Frame_CON_VEH
    connect HMIIF_Prototype.pport_If_cs_Klb_To_Hardware -> SwcTST_Prototype.rport_If_cs_Klb_To_Hardware
    connect HMIIF_Prototype.pport_If_sr_SwcKsm_Hmi_RequestGeneral -> SwcTST_Prototype.rport_If_sr_Hmi_RequestGeneral
    connect SPD_Prototype.pport_If_sr_Speed -> SwcTST_Prototype.rport_If_sr_Speed
    connect SwcDim_Prototype.pport_If_sr_Dim -> SwcTST_Prototype.rport_If_sr_Dim
    connect SwcLdm_Prototype.pport_If_sr_Ldm_CruiseControl -> SwcTST_Prototype.rport_If_sr_Ldm_CruiseControl
    connect SwcKsm_Prototype.PPort_If_sr_System -> SwcTST_Prototype.rport_If_sr_System
    connect SwcDimWrp_Prototype.pport_If_sr_Dim_Photocell -> SwcTST_Prototype.rport_If_sr_Dim_Photocell
    connect SwcTST_Prototype.pport_If_sr_Tst_Cc -> SwcCcmWrp_Prototype.rport_If_sr_Tst_SelfTestMode
    connect DiagAppl.PPort_If_DataServices_DcmDspData_Dimmwert -> DcmInstance.DataServices_DcmDspData_Dimmwert
    connect DiagAppl.PPort_If_DataServices_DcmDspData_StatusGwszAbsolut -> DcmInstance.DataServices_DcmDspData_GwszAbsolutWert
    connect DiagAppl.PPort_If_DataServices_DcmDspData_StatusGwszDisplayed -> DcmInstance.DataServices_DcmDspData_GwszAnzeigeWert
    connect DiagAppl.PPort_If_DataServices_DcmDspData_SetTimeAndDate -> DcmInstance.DataServices_DcmDspData_KombiUhrzeitDatum
    connect DiagAppl.PPort_If_DataServices_DcmDspData_ReadSensorIdent01 -> DcmInstance.DataServices_DcmDspData_Sensor1
    connect DiagAppl.PPort_If_DataServices_DcmDspData_RelativeTimeCounterMaster -> DcmInstance.DataServices_DcmDspData_StatusSystime
    connect DiagAppl.PPort_If_RoutineServices_ActivateZgwApplicationMode_Routine -> DcmInstance.RoutineServices_ActivateZgwApplicationmode
    connect DiagAppl.PPort_If_RoutineServices_ActivateZgwFlashMode_Routine -> DcmInstance.RoutineServices_ActivateZgwFlashmode
    connect DiagAppl.PPort_If_RoutineServices_ClearDiagBuffer -> DcmInstance.RoutineServices_CcMeldungsspeicherLoeschen
    connect DiagAppl.PPort_if_RoutineServices_ControlSelfTest -> DcmInstance.RoutineServices_Selbsttest
    connect SwcDim_Prototype.pport_If_cs_Dim_Diag -> DiagAppl.RPort_If_cs_Dim_Diag
package /Systems
  system Kombi
    system mapping EBConnectionEditorMappings
      data-mappings:
        sender-receiver-to-signal-mapping={data-element=SysTime.Kombi_CPUInstance.SystemComponentPrototype.SysTimeRx.timeSignal, system-signal=T_SEC_COU_REL}
        sender-receiver-to-signal-mapping={data-element=Stm.Kombi_CPUInstance.SystemComponentPrototype.CentralErrorLockRx.centralErrorLock, system-signal=ST_ILK_ERRM_FZM}
        sender-receiver-to-signal-group-mapping={data-element=Kombi_CPUInstance.SystemComponentPrototype.RP_SGG_Rx_CON_VEH.IntegrationSample_IDT_CON_VEH, signal-group=sigGroup_CON_VEH, type-mapping=sender-rec-record-type-mapping=record-element-mappings=[{implementation-record-element=IntegrationSample_CTR_BS_PRTNT, system-signal=CTR_BS_PRTNT}, {implementation-record-element=IntegrationSample_CTR_FKTN_PRTNT, system-signal=CTR_FKTN_PRTNT}, {implementation-record-element=IntegrationSample_ST_CON_VEH, system-signal=ST_CON_VEH}]}
        sender-receiver-to-signal-group-mapping={data-element=Kombi_CPUInstance.Vin.SystemComponentPrototype.ComVin.ComVin, signal-group=sigGroup_FAHRGESTELLNUMMER, type-mapping=sender-rec-record-type-mapping=record-element-mappings=[{implementation-record-element=Vin1, system-signal=NO_VECH_1}, {implementation-record-element=Vin2, system-signal=NO_VECH_2}, {implementation-record-element=Vin3, system-signal=NO_VECH_3}, {implementation-record-element=Vin4, system-signal=NO_VECH_4}, {implementation-record-element=Vin5, system-signal=NO_VECH_5}, {implementation-record-element=Vin6, system-signal=NO_VECH_6}, {implementation-record-element=Vin7, system-signal=NO_VECH_7}]}
        sender-receiver-to-signal-mapping={data-element=Kombi_CPUInstance.Vin.SystemComponentPrototype.VinRequest.RequestMessageIdentifier, system-signal=ID_FN_INQY}
        sender-receiver-to-signal-group-mapping={data-element=Kombi_CPUInstance.SPD_Prototype.SystemComponentPrototype.pport_If_sr_Port_Tx_ST_DISP_DRASY.ST_DISP_DRASY, signal-group=sigGroup_ST_DISP_DRASY, type-mapping=sender-rec-record-type-mapping=record-element-mappings=[{implementation-record-element=CRC_ST_DISP_DRASY, system-signal=CRC_ST_DISP_DRASY}, {implementation-record-element=ALIV_ST_DISP_DRASY, system-signal=ALIV_ST_DISP_DRASY}, {implementation-record-element=CHL_ST_DISP_DRASY, system-signal=CHL_ST_DISP_DRASY}, {implementation-record-element=AVL_V_SPDM_2, system-signal=AVL_V_SPDM_2}, {implementation-record-element=UN_V_SPDM, system-signal=UN_V_SPDM}, {implementation-record-element=ST_DISP_PMA, system-signal=ST_DISP_PMA}, {implementation-record-element=AVAI_DISP_KI, system-signal=AVAI_DISP_KI}, {implementation-record-element=ST_DISP_XCC, system-signal=ST_DISP_XCC}, {implementation-record-element=ST_DISP_HDC, system-signal=ST_DISP_HDC}, {implementation-record-element=ST_DISP_SD, system-signal=ST_DISP_DRASY_dummy_44_47}, {implementation-record-element=ST_DISP_DRASY_LAG, system-signal=ST_DISP_DRASY_LAG}, {implementation-record-element=ST_DISP_ISA_2, system-signal=ST_DISP_ISA_2}, {implementation-record-element=ST_DISP_GAP_INFO_2, system-signal=ST_DISP_GAP_INFO_2}, {implementation-record-element=ST_DISP_WBK, system-signal=ST_DISP_WBK}]}
        sender-receiver-to-signal-mapping={data-element=Kombi_CPUInstance.SwcUcv_Prototype.SystemComponentPrototype.pport_If_sr_Port_Tx_ANZEIGE_KI_EXTN_ANZEIGE.DISP_TEMP_EX_Tx, system-signal=DISP_TEMP_EX}
        sender-receiver-to-signal-mapping={data-element=Kombi_CPUInstance.SwcUcv_Prototype.SystemComponentPrototype.pport_If_sr_Port_Tx_ANZEIGE_KI_EXTN_ANZEIGE.ST_UN_TEMP_KI_Tx, system-signal=ST_UN_TEMP_KI}
        sender-receiver-to-signal-mapping={data-element=Kombi_CPUInstance.SwcAtp_Prototype.SystemComponentPrototype.pport_If_sr_Port_Tx_A_TEMP.TEMP_EX_Tx, system-signal=TEMP_EX}
        sender-receiver-to-signal-mapping={data-element=Kombi_CPUInstance.SwcAtp_Prototype.SystemComponentPrototype.pport_If_sr_Port_Tx_A_TEMP.TEMP_EX_UNFILT_Tx, system-signal=TEMP_EX_UNFILT}
      sw-mappings:
        swc to ecu mapping EBConnectionEditorSwcMappings: ecu-instance=Kombi
          component:
            SystemComponentPrototype.Kombi_CPUInstance.iicb_Prototype
            SystemComponentPrototype.Kombi_CPUInstance.IOSAL_Prototype
            SystemComponentPrototype.Kombi_CPUInstance.SwcCDBus_Prototype
            SystemComponentPrototype.Kombi_CPUInstance.SwcUcv_Prototype
            SystemComponentPrototype.Kombi_CPUInstance.BifSample_Prototype
            SystemComponentPrototype.Kombi_CPUInstance.CDDBIF_Prototype
            SystemComponentPrototype.Kombi_CPUInstance.SwcGear_Prototype
            SystemComponentPrototype.Kombi_CPUInstance.CddVMon_Prototype
            SystemComponentPrototype.Kombi_CPUInstance.SwcAtp_Prototype
            SystemComponentPrototype.Kombi_CPUInstance.SwcOdo_Prototype
            SystemComponentPrototype.Kombi_CPUInstance.SwcCcm_Prototype
            SystemComponentPrototype.Kombi_CPUInstance.SwcTnk_Prototype
            SystemComponentPrototype.Kombi_CPUInstance.CddErm_Prototype
            SystemComponentPrototype.Kombi_CPUInstance.SwcKlb_Prototype
            SystemComponentPrototype.Kombi_CPUInstance.HMIIF_Prototype
            SystemComponentPrototype.Kombi_CPUInstance.SwcBc_Prototype
            SystemComponentPrototype.Kombi_CPUInstance.SPD_Prototype
            SystemComponentPrototype.Kombi_CPUInstance.PiaWrp_Prototype
            SystemComponentPrototype.Kombi_CPUInstance.SwcEci_Prototype
            SystemComponentPrototype.Kombi_CPUInstance.SwcDim_Prototype
            SystemComponentPrototype.Kombi_CPUInstance.AC_SAFM_Prototype
            SystemComponentPrototype.Kombi_CPUInstance.SwcLdm_Prototype
            SystemComponentPrototype.Kombi_CPUInstance.SwcRda_Prototype
            SystemComponentPrototype.Kombi_CPUInstance.SwcElc_Prototype
            SystemComponentPrototype.Kombi_CPUInstance.CDD_AMM_Prototype
            SystemComponentPrototype.Kombi_CPUInstance.CddStub_Prototype
            SystemComponentPrototype.Kombi_CPUInstance.SwcKsm_Prototype
            SystemComponentPrototype.Kombi_CPUInstance.SwcBcWrp_Prototype
            SystemComponentPrototype.Kombi_CPUInstance.SwcDimWrp_Prototype
            SystemComponentPrototype.Kombi_CPUInstance.CddSwcDfe_Prototype
            SystemComponentPrototype.Kombi_CPUInstance.CddDfeLld_Prototype
            SystemComponentPrototype.Kombi_CPUInstance.SwcOdoWrp_Prototype
            SystemComponentPrototype.Kombi_CPUInstance.SwcCcmWrp_Prototype
            SystemComponentPrototype.Kombi_CPUInstance.SwcCbsWrp_Prototype
            SystemComponentPrototype.Kombi_CPUInstance.CddSafMLLD_Prototype
            SystemComponentPrototype.Kombi_CPUInstance.CddHal_Prototype
            SystemComponentPrototype.Kombi_CPUInstance.SwcTST_Prototype
            SystemComponentPrototype.Kombi_CPUInstance.SwcTmm_Prototype
            SystemComponentPrototype.Kombi_CPUInstance.SwcCbs_Prototype
